## app/Kconfig
```kconfig
#
# Copyright (c) 2023 Nordic Semiconductor ASA
#
# SPDX-License-Identifier: LicenseRef-Nordic-5-Clause
#

menu "cellular guard"

config MQTT_SAMPLE_PAYLOAD_CHANNEL_STRING_MAX_SIZE
	int "Payload maximum string size"
	default 100
	help
	  Maximum size of the string included messages that are sent over the payload channel.

config MQTT_SAMPLE_CAMERA_CHUNK_SIZE
	int "Camera chunk size in bytes"
	default 1024
	help
	  Size of each camera image chunk sent over MQTT. Should be 1-4 KB to balance overhead and RAM.

rsource "src/modules/trigger/Kconfig.trigger"
rsource "src/modules/sampler/Kconfig.sampler"
rsource "src/modules/network/Kconfig.network"
rsource "src/modules/transport/Kconfig.transport"
rsource "src/modules/error/Kconfig.error"
rsource "src/modules/camera/Kconfig.camera"
rsource "drivers/esp32cam/Kconfig"

endmenu

menu "Zephyr Kernel"
source "Kconfig.zephyr"
endmenu
```

## app/drivers/esp32cam/Kconfig
```kconfig
#
# ESP32-CAM custom SPI camera driver
#

menuconfig ESP32CAM_DRIVER
	bool "ESP32-CAM SPI camera driver"
	default y
	help
	  Enable the custom driver bound to the esp32,cam-spi devicetree node.

if ESP32CAM_DRIVER

config ESP32CAM_DRIVER_LOG_LEVEL
	int "ESP32-CAM driver log level"
	default 3
	range 0 4
	help
	  Log level for the ESP32-CAM driver.

endif # ESP32CAM_DRIVER
```

## app/src/modules/camera/Kconfig.camera
```kconfig
#
# Copyright (c) 2023 Nordic Semiconductor ASA
#
# SPDX-License-Identifier: LicenseRef-Nordic-5-Clause
#

menuconfig MQTT_SAMPLE_CAMERA
	bool "Enable camera module"
	default y
	help
	  Enable the camera module for ESP32-CAM communication over SPI.

if MQTT_SAMPLE_CAMERA

config MQTT_SAMPLE_CAMERA_LOG_LEVEL
	int "Camera module log level"
	default 3
	range 0 4
	help
	  Sets the log level for the camera module.

config MQTT_SAMPLE_CAMERA_THREAD_STACK_SIZE
	int "Camera module thread stack size"
	default 2048
	help
	  Stack size for the camera module thread.

config MQTT_SAMPLE_CAMERA_MESSAGE_QUEUE_SIZE
	int "Camera module message queue size"
	default 10
	help
	  Size of the message queue for the camera module.

endif # MQTT_SAMPLE_CAMERA
```
